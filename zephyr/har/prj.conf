## CMakeLists.txt
```
cmake_minimum_required(VERSION 3.20.0)
find_package(Zephyr REQUIRED HINTS $ENV{ZEPHYR_BASE})
project(har)

# Locate eml_net.h directly in the container venv or local paths
find_path(EMLEARN_INCLUDE_DIR eml_net.h
    PATHS
        /opt/venv/lib/python3.12/site-packages/emlearn
        /opt/venv/lib/python3.11/site-packages/emlearn
        /usr/local/lib/python3.12/dist-packages/emlearn
        ${CMAKE_CURRENT_SOURCE_DIR}/src
    REQUIRED
)

target_include_directories(app PRIVATE
    ${EMLEARN_INCLUDE_DIR}
    ${CMAKE_CURRENT_SOURCE_DIR}/src
)

target_sources(app PRIVATE src/main.cpp)
```

## prj.conf
```kconfig
CONFIG_PRINTK=y
CONFIG_FPU=y
CONFIG_MAIN_STACK_SIZE=16384
CONFIG_CPP=y
CONFIG_STD_CPP17=y
CONFIG_REQUIRES_FULL_LIBC=y

# Enable TensorFlow Lite Micro
CONFIG_TENSORFLOW_LITE_MICRO=y
```

## src/main.cpp
```c
#include <zephyr/kernel.h>
#include <zephyr/sys/printk.h>
#include <string.h>
#ifdef CONFIG_ARCH_POSIX
#include <nsi_main.h>
#endif

#ifdef __cplusplus
extern "C" {
#endif

// Track A: Feature vector headers & models
#include "test_samples.h"
#include "model_tree.h"
#include "model_forest.h"
#include "model_bayes.h"
#include "model_linear.h"

// Silence upstream emlearn header warnings
#pragma GCC diagnostic push
#pragma GCC diagnostic ignored "-Wunused-variable"
#pragma GCC diagnostic ignored "-Wunused-function"
#include "model_mlp.h"
#pragma GCC diagnostic pop

#ifdef __cplusplus
}
#endif

// Track B: LiteRT / TensorFlow Lite Micro
#ifdef CONFIG_TENSORFLOW_LITE_MICRO
#include <tensorflow/lite/micro/micro_interpreter.h>
#include <tensorflow/lite/micro/micro_mutable_op_resolver.h>
#include <tensorflow/lite/schema/schema_generated.h>
#include "model_cnn_data.h"

// Reserved tensor arena; full board memory fit has not been validated.
constexpr int kTensorArenaSize = 32 * 1024;
static uint8_t tensor_arena[kTensorArenaSize];
#endif

static const char* activity_names[] = {
    "WALKING", "WALKING_UPSTAIRS", "WALKING_DOWNSTAIRS",
    "SITTING", "STANDING", "LAYING"
};

void run_all_benchmarks(void) {
    printk("\n======================================================\n");
    printk("   Zephyr RTOS native_sim: Embedded HAR Benchmark     \n");
    printk("======================================================\n");
    printk("Target Ground Truth: %s (Class %d)\n\n",
           activity_names[SAMPLE_GROUND_TRUTH], SAMPLE_GROUND_TRUTH);

    // -----------------------------------------------------------
    // TRACK A: Handcrafted 561-Feature Models
    // -----------------------------------------------------------
    printk("--- Track A: Handcrafted Features (561-D) ---\n");

    // 1. Decision Tree
    int64_t t0 = k_uptime_get();
    int pred_tree = tree_model_predict(sample_features, NUM_FEATURES);
    int64_t dt_tree = k_uptime_get() - t0;
    printk("  [Decision Tree]       Pred: %-18s (Latency: %lld ms)\n",
           activity_names[pred_tree], dt_tree);

    // 2. Random Forest
    t0 = k_uptime_get();
    int pred_forest = forest_model_predict(sample_features, NUM_FEATURES);
    int64_t dt_forest = k_uptime_get() - t0;
    printk("  [Random Forest]       Pred: %-18s (Latency: %lld ms)\n",
           activity_names[pred_forest], dt_forest);

    // 3. Gaussian Naive Bayes
    t0 = k_uptime_get();
    int pred_nb = bayes_model_predict(sample_features, NUM_FEATURES);
    int64_t dt_nb = k_uptime_get() - t0;
    printk("  [Gaussian NB]         Pred: %-18s (Latency: %lld ms)\n",
           activity_names[pred_nb], dt_nb);

    // 4. Logistic / Linear Regression
    t0 = k_uptime_get();
    int pred_linear = linear_model_predict(sample_features, NUM_FEATURES);
    int64_t dt_linear = k_uptime_get() - t0;
    printk("  [Logistic/Linear]     Pred: %-18s (Latency: %lld ms)\n",
           activity_names[pred_linear], dt_linear);

    // 5. Multi-Layer Perceptron (MLP)
    t0 = k_uptime_get();
    int pred_mlp = mlp_model_predict(sample_features, NUM_FEATURES);
    int64_t dt_mlp = k_uptime_get() - t0;
    printk("  [MLP Neural Net]      Pred: %-18s (Latency: %lld ms)\n",
           activity_names[pred_mlp], dt_mlp);

    // -----------------------------------------------------------
    // TRACK B: End-to-End 1D-CNN (LiteRT / TFLM)
    // -----------------------------------------------------------
    printk("\n--- Track B: Raw Signals (128 steps x 9 channels) ---\n");

#ifdef CONFIG_TENSORFLOW_LITE_MICRO
    const tflite::Model* model = tflite::GetModel(cnn_model_tflite);
    if (model->version() != TFLITE_SCHEMA_VERSION) {
        printk("  [1D-CNN Error] Model schema version mismatch!\n");
        return;
    }

    // Increased capacity to hold all required ops
    tflite::MicroMutableOpResolver<12> resolver;
    resolver.AddQuantize();
    resolver.AddDequantize();
    resolver.AddConv2D();
    resolver.AddMaxPool2D();
    resolver.AddMean();
    resolver.AddFullyConnected();
    resolver.AddSoftmax();
    resolver.AddExpandDims();  // <-- Resolves 'EXPAND_DIMS' missing op
    resolver.AddReshape();     // <-- Common companion to ExpandDims
    resolver.AddRelu();
    resolver.AddPad();

    tflite::MicroInterpreter interpreter(model, resolver, tensor_arena, kTensorArenaSize);
    if (interpreter.AllocateTensors() != kTfLiteOk) {
        printk("  [1D-CNN Error] AllocateTensors() failed!\n");
        return;
    }

    TfLiteTensor* input = interpreter.input(0);
    memcpy(input->data.f, sample_raw_stream, RAW_SIGNAL_LEN * sizeof(float));

    t0 = k_uptime_get();
    if (interpreter.Invoke() != kTfLiteOk) {
        printk("  [1D-CNN Error] Invoke() failed!\n");
        return;
    }
    int64_t dt_cnn = k_uptime_get() - t0;

    TfLiteTensor* output = interpreter.output(0);
    int cnn_pred = 0;
    float max_prob = -1e9f;

    for (int i = 0; i < 6; i++) {
        float prob = output->data.f[i];
        if (prob > max_prob) {
            max_prob = prob;
            cnn_pred = i;
        }
    }

    printk("  [1D-CNN LiteRT]       Pred: %-18s (Latency: %lld ms)\n",
           activity_names[cnn_pred], dt_cnn);
#else
    printk("  [1D-CNN LiteRT]       Disabled (Set CONFIG_TENSORFLOW_LITE_MICRO=y in prj.conf)\n");
#endif

    printk("======================================================\n");
}

int main(void) {
    run_all_benchmarks();
#ifdef CONFIG_ARCH_POSIX
    nsi_exit(0);
#endif
    return 0;
}
```

## src/model_tree.h
```c
    // !!! This file is generated using emlearn !!!

    #include <stdint.h>


static inline int32_t tree_model_tree_0(const float *features, int32_t features_length) {
          if (features[52] < 0.096184f) {
              return 5;
          } else {
              if (features[389] < -0.973933f) {
                  if (features[559] < 0.140470f) {
                      if (features[57] < -0.999805f) {
                          if (features[54] < 0.061538f) {
                              if (features[54] < -0.202561f) {
                                  return 3;
                              } else {
                                  return 4;
                              }
                          } else {
                              if (features[169] < -0.982996f) {
                                  if (features[107] < 0.410804f) {
                                      return 3;
                                  } else {
                                      return 4;
                                  }
                              } else {
                                  return 4;
                              }
                          }
                      } else {
                          if (features[129] < -0.869326f) {
                              if (features[159] < 0.417847f) {
                                  if (features[52] < 0.989985f) {
                                      if (features[145] < -0.690944f) {
                                          return 4;
                                      } else {
                                          return 3;
                                      }
                                  } else {
                                      if (features[54] < 0.066904f) {
                                          return 3;
                                      } else {
                                          return 4;
                                      }
                                  }
                              } else {
                                  if (features[52] < 0.961469f) {
                                      if (features[133] < 0.926842f) {
                                          return 3;
                                      } else {
                                          return 4;
                                      }
                                  } else {
                                      if (features[469] < -0.999894f) {
                                          return 4;
                                      } else {
                                          return 3;
                                      }
                                  }
                              }
                          } else {
                              if (features[50] < 0.069030f) {
                                  if (features[443] < -0.986801f) {
                                      if (features[236] < 0.242942f) {
                                          return 4;
                                      } else {
                                          return 3;
                                      }
                                  } else {
                                      if (features[139] < -0.976928f) {
                                          return 3;
                                      } else {
                                          return 4;
                                      }
                                  }
                              } else {
                                  return 3;
                              }
                          }
                      }
                  } else {
                      if (features[132] < 0.845141f) {
                          if (features[129] < -0.892776f) {
                              return 3;
                          } else {
                              if (features[157] < 0.655568f) {
                                  if (features[101] < -0.980424f) {
                                      if (features[149] < -0.545367f) {
                                          return 4;
                                      } else {
                                          return 4;
                                      }
                                  } else {
                                      if (features[432] < -0.982499f) {
                                          return 3;
                                      } else {
                                          return 4;
                                      }
                                  }
                              } else {
                                  if (features[538] < -0.276564f) {
                                      return 4;
                                  } else {
                                      return 3;
                                  }
                              }
                          }
                      } else {
                          if (features[53] < -0.139188f) {
                              if (features[409] < -0.999570f) {
                                  return 4;
                              } else {
                                  return 3;
                              }
                          } else {
                              if (features[556] < -0.449001f) {
                                  return 4;
                              } else {
                                  if (features[263] < -0.208986f) {
                                      if (features[175] < -0.982291f) {
                                          return 4;
                                      } else {
                                          return 3;
                                      }
                                  } else {
                                      return 3;
                                  }
                              }
                          }
                      }
                  }
              } else {
                  if (features[508] < -0.524618f) {
                      if (features[74] < 0.563765f) {
                          if (features[448] < -0.966667f) {
                              if (features[275] < -0.297959f) {
                                  if (features[37] < -0.219034f) {
                                      if (features[558] < -0.651190f) {
                                          return 2;
                                      } else {
                                          return 1;
                                      }
                                  } else {
                                      if (features[284] < -0.069347f) {
                                          return 0;
                                      } else {
                                          return 1;
                                      }
                                  }
                              } else {
                                  if (features[49] < 0.889806f) {
                                      if (features[304] < -0.399799f) {
                                          return 1;
                                      } else {
                                          return 2;
                                      }
                                  } else {
                                      return 2;
                                  }
                              }
                          } else {
                              if (features[222] < -0.342661f) {
                                  if (features[41] < -0.206042f) {
                                      if (features[117] < -0.007050f) {
                                          return 1;
                                      } else {
                                          return 0;
                                      }
                                  } else {
                                      if (features[165] < -0.447605f) {
                                          return 2;
                                      } else {
                                          return 0;
                                      }
                                  }
                              } else {
                                  if (features[37] < -0.466966f) {
                                      if (features[328] < -0.555012f) {
                                          return 2;
                                      } else {
                                          return 1;
                                      }
                                  } else {
                                      if (features[503] < -0.261554f) {
                                          return 0;
                                      } else {
                                          return 1;
                                      }
                                  }
                              }
                          }
                      } else {
                          if (features[52] < 0.956441f) {
                              if (features[57] < -0.973934f) {
                                  if (features[67] < -0.803823f) {
                                      return 2;
                                  } else {
                                      return 0;
                                  }
                              } else {
                                  if (features[71] < -0.305978f) {
                                      if (features[9] < -0.363877f) {
                                          return 0;
                                      } else {
                                          return 1;
                                      }
                                  } else {
                                      if (features[117] < -0.003313f) {
                                          return 1;
                                      } else {
                                          return 0;
                                      }
                                  }
                              }
                          } else {
                              if (features[222] < -0.294308f) {
                                  if (features[420] < -0.920270f) {
                                      return 1;
                                  } else {
                                      return 2;
                                  }
                              } else {
                                  if (features[537] < -0.974359f) {
                                      return 2;
                                  } else {
                                      if (features[461] < -0.936513f) {
                                          return 2;
                                      } else {
                                          return 0;
                                      }
                                  }
                              }
                          }
                      }
                  } else {
                      if (features[159] < 0.275685f) {
                          if (features[67] < -0.444968f) {
                              if (features[418] < -0.964369f) {
                                  if (features[302] < -0.386947f) {
                                      return 1;
                                  } else {
                                      return 2;
                                  }
                              } else {
                                  if (features[89] < -0.512452f) {
                                      if (features[163] < -0.305786f) {
                                          return 0;
                                      } else {
                                          return 1;
                                      }
                                  } else {
                                      if (features[9] < 0.047959f) {
                                          return 1;
                                      } else {
                                          return 2;
                                      }
                                  }
                              }
                          } else {
                              if (features[471] < -0.959088f) {
                                  return 2;
                              } else {
                                  return 0;
                              }
                          }
                      } else {
                          if (features[393] < -0.474559f) {
                              return 1;
                          } else {
                              if (features[481] < -0.977430f) {
                                  return 0;
                              } else {
                                  return 2;
                              }
                          }
                      }
                  }
              }
          }
        }


int32_t tree_model_predict(const float *features, int32_t features_length) {

        int32_t votes[6] = {0,};
        int32_t _class = -1;

        _class = tree_model_tree_0(features, features_length); votes[_class] += 1;

        int32_t most_voted_class = -1;
        int32_t most_voted_votes = 0;
        for (int32_t i=0; i<6; i++) {

            if (votes[i] > most_voted_votes) {
                most_voted_class = i;
                most_voted_votes = votes[i];
            }
        }
        return most_voted_class;
    }


int tree_model_predict_proba(const float *features, int32_t features_length, float *out, int out_length) {

        int32_t _class = -1;

        for (int i=0; i<out_length; i++) {
            out[i] = 0.0f;
        }

        _class = tree_model_tree_0(features, features_length); out[_class] += 1.0f;

        // compute mean
        for (int i=0; i<out_length; i++) {
            out[i] = out[i] / 1;
        }
        return 0;
    }
```

## src/test_samples.h
```c
#ifndef TEST_SAMPLES_H
#define TEST_SAMPLES_H

#define SAMPLE_GROUND_TRUTH 4 // STANDING

#define NUM_FEATURES 561
static const float sample_features[NUM_FEATURES] = {
0.257178f, -0.023285f, -0.014654f, -0.938404f, -0.920091f, -0.667683f, -0.952501f, -0.925249f, -0.674302f, -0.894088f, -0.554577f, -0.466223f, 0.717208f, 0.635502f, 0.789497f, -0.877764f, -0.997766f, -0.998414f, -0.934345f, -0.975669f, -0.949824f, -0.830478f, -0.168084f, -0.378996f, 0.246217f, 0.521204f, -0.487793f, 0.482280f, -0.045462f, 0.211955f, -0.134894f, 0.130858f, -0.014176f, -0.105971f, 0.073544f, -0.171516f, 0.040063f, 0.076989f, -0.490546f, -0.709003f, 0.936489f, -0.282719f, 0.115288f, -0.925427f, -0.937014f, -0.564288f, -0.930020f, -0.937822f, -0.605588f, 0.906083f, -0.279244f, 0.152895f, 0.944461f, -0.262160f, -0.076162f, -0.017827f, 0.829297f, -0.864621f, -0.967795f, -0.949727f, -0.946119f, -0.759718f, -0.424975f, -1.000000f, 0.219227f, -0.430254f, 0.431048f, -0.431839f, 0.432774f, -0.795468f, 0.781314f, -0.780391f, 0.785272f, -0.984410f, 0.987180f, -0.989415f, 0.987686f, 0.980580f, -0.996352f, -0.960117f, 0.072046f, 0.045754f, -0.106043f, -0.906683f, -0.938016f, -0.935936f, -0.916081f, -0.936725f, -0.949054f, -0.903224f, -0.949818f, -0.891403f, 0.898479f, 0.950182f, 0.946153f, -0.930673f, -0.995046f, -0.997496f, -0.997016f, -0.936416f, -0.946874f, -0.968775f, -0.085174f, -0.310263f, -0.510288f, 0.521482f, -0.225890f, 0.491728f, 0.312756f, 0.229797f, 0.113959f, 0.219879f, 0.422975f, -0.082633f, 0.140427f, -0.196232f, 0.072358f, -0.264860f, 0.035852f, -0.349735f, 0.119976f, -0.091792f, 0.189629f, -0.883089f, -0.816164f, -0.940881f, -0.888612f, -0.857801f, -0.945818f, -0.663411f, -0.713437f, -0.648679f, 0.837100f, 0.825257f, 0.810977f, -0.796500f, -0.979616f, -0.982900f, -0.994037f, -0.886558f, -0.906104f, -0.958049f, 0.774033f, -0.267706f, 0.452248f, -0.078451f, -0.012579f, 0.235982f, -0.199048f, 0.033918f, -0.080781f, 0.006999f, 0.244886f, 0.216517f, -0.279681f, 0.249739f, 0.017720f, 0.648465f, -0.236931f, -0.301735f, -0.204896f, -0.174488f, -0.093389f, -0.901224f, -0.910860f, -0.939250f, -0.910363f, -0.927357f, -0.953554f, -0.867914f, -0.913498f, -0.897578f, 0.904937f, 0.917308f, 0.947612f, -0.929609f, -0.994686f, -0.995791f, -0.997813f, -0.936541f, -0.958880f, -0.970348f, 0.036619f, 0.076460f, -0.197126f, 0.106514f, -0.020812f, 0.193258f, 0.304479f, 0.115729f, 0.054150f, 0.068951f, 0.197050f, 0.309928f, -0.212657f, 0.173178f, 0.145845f, 0.124009f, -0.155346f, -0.323437f, -0.866929f, -0.705191f, -0.744022f, -0.760796f, -0.981649f, -0.866929f, -0.980166f, -0.859474f, 0.255104f, 0.053780f, -0.204144f, 0.610528f, -0.564449f, -0.866929f, -0.705191f, -0.744022f, -0.760796f, -0.981649f, -0.866929f, -0.980166f, -0.859474f, 0.255104f, 0.053780f, -0.204144f, 0.610528f, -0.564449f, -0.929767f, -0.895994f, -0.900417f, -0.903004f, -0.975011f, -0.929767f, -0.995608f, -0.914121f, -0.129552f, 0.238911f, -0.345597f, 0.326462f, -0.263048f, -0.795544f, -0.762073f, -0.782672f, -0.716594f, -0.764193f, -0.795544f, -0.974152f, -0.839581f, 0.667563f, 0.035621f, -0.161894f, 0.153250f, -0.006760f, -0.925195f, -0.894344f, -0.900147f, -0.916737f, -0.976367f, -0.925195f, -0.995824f, -0.911837f, 0.331654f, 0.516953f, -0.513504f, 0.041320f, 0.011835f, -0.918510f, -0.918213f, -0.789091f, -0.948290f, -0.925137f, -0.636317f, -0.930680f, -0.924438f, -0.724903f, -0.968424f, -0.940137f, -0.597189f, -0.966137f, -0.984451f, -0.952087f, -0.865063f, -0.997844f, -0.996036f, -0.940195f, -0.904840f, -0.933812f, -0.869383f, -0.339673f, -0.485803f, -0.166258f, -1.000000f, -1.000000f, -1.000000f, 0.011117f, 0.121251f, -0.522949f, -0.571999f, -0.894612f, -0.338266f, -0.686797f, 0.189553f, -0.113596f, -0.998506f, -0.997943f, -0.995598f, -0.995036f, -0.995977f, -0.991487f, -0.992131f, -0.999775f, -0.998204f, -0.994747f, -0.994309f, -0.994693f, -0.998020f, -0.993727f, -0.996209f, -0.997976f, -0.998921f, -0.996401f, -0.997560f, -0.995068f, -0.997351f, -0.998238f, -0.996071f, -0.997925f, -0.996357f, -0.997640f, -0.996220f, -0.996225f, -0.924705f, -0.994097f, -0.995323f, -0.998969f, -0.997902f, -0.994930f, -0.989261f, -0.980085f, -0.937937f, -0.996678f, -0.997025f, -0.986427f, -0.939201f, -0.998432f, -0.899633f, -0.937485f, -0.923551f, -0.924429f, -0.943210f, -0.947892f, -0.896615f, -0.938309f, -0.942576f, -0.948634f, -0.958325f, -0.958817f, -0.943882f, -0.987303f, -0.978466f, -0.905274f, -0.995036f, -0.997499f, -0.997031f, -0.887077f, -0.935820f, -0.953653f, -0.470662f, -0.672172f, -0.596274f, -0.520000f, 0.080000f, 0.320000f, 0.451005f, 0.137167f, -0.180299f, -0.580086f, -0.908070f, -0.625527f, -0.942757f, -0.661910f, -0.911532f, -0.999011f, -0.997630f, -0.995985f, -0.994708f, -0.995572f, -0.987877f, -0.986445f, -0.998205f, -0.998040f, -0.994497f, -0.992050f, -0.986333f, -0.996894f, -0.990763f, -0.999409f, -0.998648f, -0.998749f, -0.996406f, -0.997172f, -0.994530f, -0.997920f, -0.999970f, -0.998642f, -0.997402f, -0.995411f, -0.998182f, -0.998463f, -0.995996f, -0.993639f, -0.997838f, -0.997129f, -0.998749f, -0.996709f, -0.995110f, -0.998486f, -0.999094f, -0.995925f, -0.997951f, -0.996013f, -0.998460f, -0.996267f, -0.997700f, -0.823558f, -0.807916f, -0.917913f, -0.903263f, -0.822677f, -0.956165f, -0.865127f, -0.831801f, -0.941056f, -0.904798f, -0.879257f, -0.967788f, -0.878599f, -0.948329f, -0.919685f, -0.828472f, -0.992950f, -0.982663f, -0.997993f, -0.878894f, -0.838152f, -0.929140f, 0.000758f, 0.200144f, -0.253384f, -1.000000f, -0.935484f, -0.931034f, 0.184035f, -0.059323f, 0.438107f, -0.395423f, -0.698762f, -0.387457f, -0.786394f, -0.485654f, -0.786815f, -0.994629f, -0.990469f, -0.992778f, -0.995680f, -0.987078f, -0.986651f, -0.984114f, -0.985250f, -0.993553f, -0.992430f, -0.985606f, -0.984617f, -0.993269f, -0.992725f, -0.977928f, -0.994852f, -0.997819f, -0.994843f, -0.992410f, -0.988123f, -0.990433f, -0.987961f, -0.981791f, -0.996399f, -0.991452f, -0.988060f, -0.982048f, -0.993380f, -0.998878f, -0.998367f, -0.998467f, -0.998375f, -0.998906f, -0.995894f, -0.993128f, -0.995472f, -0.998387f, -0.997754f, -0.998096f, -0.994148f, -0.998191f, -0.998290f, -0.790946f, -0.711074f, -0.726707f, -0.777697f, -0.944881f, -0.790946f, -0.953984f, -0.873543f, -0.174593f, -1.000000f, -0.483453f, 0.011041f, -0.384517f, -0.895061f, -0.896360f, -0.888197f, -0.928466f, -0.898100f, -0.895061f, -0.993471f, -0.921477f, -0.484619f, -1.000000f, -0.035356f, -0.254248f, -0.700326f, -0.770610f, -0.797113f, -0.764485f, -0.820188f, -0.937959f, -0.770610f, -0.970958f, -0.798387f, 0.179435f, -1.000000f, -0.047391f, -0.467849f, -0.761326f, -0.890165f, -0.907308f, -0.895301f, -0.917883f, -0.909829f, -0.890165f, -0.994105f, -0.898022f, -0.234815f, -1.000000f, 0.071645f, -0.330370f, -0.705974f, 0.006462f, 0.162920f, -0.825886f, 0.271151f, -0.720009f, 0.276801f, -0.057978f
};

#define RAW_SIGNAL_LEN 1152
static const float sample_raw_stream[RAW_SIGNAL_LEN] = {
0.011653f, -0.029399f, 0.106826f, 1.041216f, -0.269796f, 0.023780f, 0.437464f, 0.531349f, 0.136528f, 0.013109f, -0.039729f, 0.152455f, 1.041803f, -0.280025f, 0.076293f, 0.468264f, 0.721069f, 0.097622f, 0.011269f, -0.052406f, 0.216846f, 1.039086f, -0.292663f, 0.147475f, 0.498257f, 0.520328f, 0.083556f, 0.027831f, -0.052106f, 0.202581f, 1.054768f, -0.292384f, 0.139906f, 0.479396f, 0.372625f, 0.022861f, 0.002318f, -0.045470f, 0.176010f, 1.028376f, -0.285826f, 0.119934f, 0.389894f, 0.414541f, -0.025939f, -0.018965f, -0.037764f, 0.183770f, 1.006216f, -0.278253f, 0.134195f, 0.306651f, 0.333328f, -0.027142f, -0.061920f, -0.018047f, 0.176536f, 0.962391f, -0.258723f, 0.133364f, 0.294976f, 0.278828f, -0.036793f, -0.094248f, -0.008505f, 0.179360f, 0.929196f, -0.249419f, 0.142489f, 0.306118f, 0.270581f, -0.032477f, -0.079534f, -0.021784f, 0.191601f, 0.943047f, -0.262981f, 0.160931f, 0.262660f, 0.071018f, 0.006943f, -0.070084f, -0.021365f, 0.166247f, 0.951635f, -0.262891f, 0.141676f, 0.256775f, 0.004640f, 0.046590f, -0.019152f, -0.015552f, 0.141120f, 1.001703f, -0.257446f, 0.122549f, 0.274413f, 0.106045f, 0.031843f, -0.002267f, -0.026529f, 0.138818f, 1.017726f, -0.268829f, 0.126142f, 0.266774f, 0.087839f, 0.017572f, -0.030111f, -0.038053f, 0.146168f, 0.989020f, -0.280794f, 0.139284f, 0.308899f, 0.071261f, 0.024124f, -0.011910f, -0.049178f, 0.160429f, 1.006362f, -0.292393f, 0.159233f, 0.297918f, 0.056652f, 0.006829f, -0.015542f, -0.041249f, 0.155868f, 1.001875f, -0.284969f, 0.160254f, 0.259624f, 0.032024f, 0.012108f, -0.016666f, -0.013729f, 0.142497f, 0.999901f, -0.257984f, 0.152362f, 0.279757f, 0.050315f, 0.022127f, -0.006630f, -0.009588f, 0.136311f, 1.009093f, -0.254406f, 0.151550f, 0.242333f, 0.037738f, 0.006271f, -0.023481f, -0.016430f, 0.122482f, 0.991405f, -0.261836f, 0.142991f, 0.216806f, 0.043260f, 0.009272f, -0.017628f, -0.012812f, 0.114862f, 0.996430f, -0.258827f, 0.140537f, 0.227879f, 0.052217f, 0.028719f, -0.021150f, -0.008535f, 0.116429f, 0.992089f, -0.255179f, 0.147164f, 0.211397f, 0.040560f, 0.028644f, -0.032659f, -0.005880f, 0.112779f, 0.979770f, -0.253170f, 0.148471f, 0.223008f, 0.019124f, 0.015175f, -0.022478f, -0.015395f, 0.107006f, 0.989151f, -0.263346f, 0.147549f, 0.226676f, -0.019848f, 0.013494f, -0.010197f, -0.021883f, 0.094605f, 1.000643f, -0.270507f, 0.139895f, 0.223738f, 0.014792f, 0.015582f, -0.003120f, -0.003203f, 0.085584f, 1.006941f, -0.252510f, 0.135514f, 0.225648f, 0.048439f, 0.021800f, -0.016496f, 0.010654f, 0.094395f, 0.992796f, -0.239344f, 0.148861f, 0.218124f, -0.003735f, 0.014387f, -0.020442f, -0.007521f, 0.097822f, 0.988095f, -0.258216f, 0.156717f, 0.233893f, -0.058463f, -0.011859f, -0.027568f, -0.024191f, 0.088231f, 0.980225f, -0.275586f, 0.151451f, 0.241534f, -0.124569f, -0.005913f, -0.055032f, -0.007172f, 0.080695f, 0.952029f, -0.259268f, 0.148135f, 0.225529f, -0.227082f, 0.054301f, -0.057480f, 0.007895f, 0.068327f, 0.948862f, -0.244904f, 0.139883f, 0.169200f, -0.288265f, 0.139202f, -0.047096f, 0.008796f, 0.049332f, 0.958535f, -0.244704f, 0.124899f, 0.113243f, -0.213277f, 0.155446f, -0.028362f, 0.014163f, 0.039514f, 0.976567f, -0.240035f, 0.118988f, 0.092249f, -0.073297f, 0.115680f, -0.017185f, -0.002967f, 0.047212f, 0.987049f, -0.257857f, 0.130488f, 0.048371f, -0.029598f, 0.096341f, -0.007376f, -0.026368f, 0.051300f, 0.996171f, -0.281942f, 0.138273f, 0.057258f, -0.054680f, 0.061591f, 0.024779f, -0.021290f, 0.030868f, 1.027648f, -0.277541f, 0.121431f, 0.115853f, -0.050256f, 0.059473f, 0.023929f, -0.020706f, 0.013931f, 1.026131f, -0.277624f, 0.107979f, 0.187365f, -0.005992f, 0.068097f, 0.021248f, -0.030565f, 0.019780f, 1.022794f, -0.288143f, 0.117206f, 0.328658f, 0.025251f, 0.013594f, 0.009700f, -0.022419f, 0.022582f, 1.010605f, -0.280649f, 0.123279f, 0.372719f, -0.006524f, 0.011525f, -0.035119f, -0.008934f, 0.015715f, 0.965160f, -0.267807f, 0.119577f, 0.290491f, -0.059913f, 0.046115f, -0.010733f, -0.002858f, 0.014008f, 0.988936f, -0.262367f, 0.120927f, 0.251146f, -0.063631f, 0.048039f, 0.023672f, 0.005165f, 0.012801f, 1.022747f, -0.254969f, 0.122670f, 0.200866f, 0.040708f, 0.050843f, 0.014930f, 0.006896f, 0.008756f, 1.013427f, -0.253853f, 0.121468f, 0.132497f, 0.177502f, 0.038661f, 0.021906f, 0.001812f, 0.007932f, 1.019843f, -0.259541f, 0.123382f, 0.130611f, 0.141725f, 0.038962f, 0.005084f, -0.003700f, 0.007130f, 1.002479f, -0.265644f, 0.125213f, 0.139286f, 0.019043f, 0.039850f, -0.013070f, -0.014692f, 0.008563f, 0.983802f, -0.277214f, 0.129174f, 0.111512f, 0.013917f, 0.025063f, -0.007981f, -0.014561f, 0.011334f, 0.988388f, -0.277648f, 0.134370f, 0.108198f, 0.019292f, 0.033066f, -0.012764f, -0.007670f, 0.009463f, 0.983120f, -0.271309f, 0.134822f, 0.129734f, -0.026264f, 0.036341f, -0.009869f, -0.010652f, 0.006357f, 0.985549f, -0.274828f, 0.133938f, 0.125542f, -0.045058f, 0.051158f, -0.003697f, -0.008291f, -0.002158f, 0.991271f, -0.272992f, 0.127546f, 0.156439f, -0.058191f, 0.066792f, 0.004781f, -0.009688f, -0.012968f, 0.999317f, -0.274902f, 0.118762f, 0.225354f, -0.047182f, 0.055426f, 0.007929f, -0.016831f, -0.017078f, 1.002052f, -0.282542f, 0.116582f, 0.250885f, -0.022537f, 0.061885f, -0.000549f, -0.011010f, -0.018645f, 0.993176f, -0.277207f, 0.116849f, 0.198785f, -0.034753f, 0.064159f, -0.000915f, -0.004164f, -0.017778f, 0.992430f, -0.270834f, 0.119456f, 0.125359f, -0.057137f, 0.059309f, -0.004987f, -0.000390f, -0.012985f, 0.987996f, -0.267521f, 0.125895f, 0.164856f, -0.086109f, 0.062419f, 0.009075f, 0.000401f, -0.005478f, 1.001712f, -0.267177f, 0.134958f, 0.239585f, -0.082565f, 0.055187f, 0.033041f, -0.003548f, -0.005578f, 1.025348f, -0.271560f, 0.136324f, 0.261495f, -0.045124f, 0.050021f, 0.019763f, 0.000423f, -0.026412f, 1.011759f, -0.268010f, 0.116867f, 0.264604f, -0.012531f, 0.019868f, 0.000010f, 0.005835f, -0.050888f, 0.991712f, -0.263006f, 0.093682f, 0.154773f, 0.028875f, -0.011089f, -0.017139f, 0.008277f, -0.051185f, 0.974287f, -0.260958f, 0.094592f, 0.055753f, -0.012028f, 0.029292f, -0.029958f, 0.009783f, -0.033930f, 0.961210f, -0.259832f, 0.112969f, 0.099613f, -0.083234f, 0.077411f, -0.009448f, 0.004626f, -0.025010f, 0.981476f, -0.265353f, 0.122927f, 0.121137f, -0.055579f, 0.063260f, 0.005134f, 0.000572f, -0.026208f, 0.995829f, -0.269758f, 0.122685f, 0.111827f, -0.053735f, 0.052812f, -0.002512f, -0.002827f, -0.025903f, 0.987968f, -0.273492f, 0.123865f, 0.140053f, -0.077577f, 0.068011f, 0.003219f, -0.005553f, -0.023807f, 0.993498f, -0.276540f, 0.126759f, 0.164473f, -0.053806f, 0.057166f, 0.012330f, -0.001471f, -0.024541f, 1.002419f, -0.272764f, 0.126747f, 0.166305f, -0.052454f, 0.051457f, 0.009280f, 0.006651f, -0.026319f, 0.999192f, -0.264935f, 0.125616f, 0.170288f, -0.061374f, 0.055096f, 0.004930f, 0.018650f, -0.026888f, 0.994679f, -0.253214f, 0.125625f, 0.175222f, -0.095364f, 0.043344f, 0.003954f, 0.015539f, -0.036639f, 0.993552f, -0.256589f, 0.116381f, 0.130862f, -0.146450f, 0.052398f, 0.009214f, -0.000574f, -0.045893f, 0.998674f, -0.272952f, 0.107567f, 0.078856f, -0.126174f, 0.059709f, 0.016156f, -0.003364f, -0.038449f, 1.005490f, -0.275976f, 0.115386f, 0.082496f, -0.092850f, 0.054433f, 0.014079f, -0.002116f, -0.030481f, 1.003300f, -0.274949f, 0.123665f, 0.124282f, -0.085435f, 0.054009f, 0.013105f, -0.000707f, -0.028727f, 1.002225f, -0.273747f, 0.125667f, 0.150259f, -0.051600f, 0.036292f, 0.021247f, -0.002639f, -0.030717f, 1.010279f, -0.275873f, 0.123866f, 0.111499f, -0.007535f, 0.025440f, 0.026823f, -0.008448f, -0.032612f, 1.015780f, -0.281863f, 0.122103f, 0.081257f, 0.053288f, 0.025910f, 0.031054f, -0.000613f, -0.023494f, 1.019949f, -0.274197f, 0.131297f, 0.127074f, 0.162047f, 0.020231f, 0.037886f, 0.007368f, -0.014509f, 1.026733f, -0.266373f, 0.140306f, 0.153342f, 0.262271f, 0.025096f, 0.026463f, 0.012681f, -0.011135f, 1.015277f, -0.261207f, 0.143654f, 0.093837f, 0.239156f, 0.034697f, -0.021441f, 0.017177f, 0.001992f, 0.967356f, -0.256846f, 0.156707f, 0.046081f, 0.068246f, 0.042653f, -0.060568f, 0.011498f, 0.018666f, 0.928225f, -0.262648f, 0.173264f, 0.067916f, -0.062734f, 0.041929f, -0.024725f, 0.007790f, 0.013491f, 0.964076f, -0.266468f, 0.167933f, 0.076728f, -0.012310f, 0.034226f, 0.020272f, 0.001398f, 0.001561f, 1.009091f, -0.272960f, 0.155811f, 0.065514f, 0.042170f, 0.034397f, -0.001934f, -0.002151f, 0.007113f, 0.986909f, -0.276598f, 0.161139f, 0.077630f, -0.007754f, 0.031705f, -0.008907f, 0.003351f, 0.006369f, 0.979969f, -0.271174f, 0.160141f, 0.079482f, -0.004052f, 0.029588f, 0.009538f, 0.001304f, 0.004296f, 0.998452f, -0.273288f, 0.157789f, 0.076519f, 0.021575f, 0.027944f, -0.004332f, 0.002976f, 0.013948f, 0.984628f, -0.271674f, 0.167140f, 0.084093f, -0.016314f, 0.020128f, -0.001864f, 0.009296f, 0.013180f, 0.987147f, -0.265403f, 0.166051f, 0.078130f, -0.008571f, 0.024881f, 0.004955f, 0.010398f, 0.010319f, 0.994021f, -0.264340f, 0.162852f, 0.074793f, 0.001129f, 0.029842f, -0.005336f, 0.008614f, 0.008818f, 0.983790f, -0.266155f, 0.160998f, 0.077390f, -0.014713f, 0.024858f, 0.002001f, 0.003315f, 0.006970f, 0.991191f, -0.271474f, 0.158785f, 0.070863f, 0.000104f, 0.027249f, -0.001708f, 0.005787f, 0.009000f, 0.987550f, -0.269015f, 0.160443f, 0.071056f, -0.020725f, 0.029842f, -0.006463f, 0.008873f, 0.000461f, 0.982864f, -0.265933f, 0.151523f, 0.073954f, -0.031531f, 0.032520f, 0.000204f, 0.004834f, -0.002703f, 0.989604f, -0.269969f, 0.147972f, 0.076099f, -0.021525f, 0.038938f, -0.003640f, 0.005370f, 0.003882f, 0.985835f, -0.269421f, 0.154167f, 0.083582f, -0.037105f, 0.040845f, 0.000083f, 0.004103f, 0.003865f, 0.989633f, -0.270669f, 0.153757f, 0.088561f, -0.038409f, 0.043893f, -0.001442f, 0.003983f, 0.002233f, 0.988186f, -0.270762f, 0.151731f, 0.093163f, -0.056909f, 0.049163f, -0.005959f, 0.008613f, -0.002988f, 0.983746f, -0.266098f, 0.146116f, 0.091971f, -0.071310f, 0.057354f, 0.000344f, 0.008008f, -0.005691f, 0.990127f, -0.266663f, 0.143020f, 0.090115f, -0.072261f, 0.068955f, 0.000558f, 0.007645f, -0.004712f, 0.990419f, -0.266980f, 0.143608f, 0.094705f, -0.087107f, 0.074506f, 0.002381f, 0.007352f, -0.003659f, 0.992320f, -0.267220f, 0.144273f, 0.095234f, -0.085039f, 0.075187f, 0.001828f, 0.005151f, 0.002027f, 0.991844f, -0.269363f, 0.149575f, 0.099335f, -0.091467f, 0.075591f, -0.001456f, 0.004070f, 0.003147f, 0.988636f, -0.270380f, 0.150313f, 0.100549f, -0.092761f, 0.078023f, -0.000200f, 0.001317f, 0.003176f, 0.989968f, -0.273063f, 0.149967f, 0.090311f, -0.087743f, 0.081374f, -0.000570f, 0.001404f, 0.004010f, 0.989673f, -0.272901f, 0.150430f, 0.081726f, -0.097990f, 0.082315f, 0.002605f, 0.002011f, 0.002885f, 0.992922f, -0.272216f, 0.148942f, 0.079611f, -0.092559f, 0.082328f, 0.002644f, 0.000030f, 0.004277f, 0.993034f, -0.274113f, 0.149977f, 0.086656f, -0.089428f, 0.078398f, 0.001597f, 0.002204f, 0.002610f, 0.992059f, -0.271853f, 0.147962f, 0.097852f, -0.089135f, 0.074116f, 0.003818f, 0.003985f, 0.003378f, 0.994351f, -0.269983f, 0.148390f, 0.114268f, -0.096017f, 0.073589f, 0.001648f, 0.001535f, 0.006166f, 0.992251f, -0.272341f, 0.150847f, 0.134854f, -0.117307f, 0.074236f, 0.002943f, -0.000695f, 0.006371f, 0.993614f, -0.274476f, 0.150729f, 0.146703f, -0.116654f, 0.076116f, 0.005582f, -0.001549f, 0.008495f, 0.996321f, -0.275233f, 0.152542f, 0.157344f, -0.109042f, 0.069591f, 0.006257f, 0.000269f, 0.007704f, 0.997062f, -0.273316f, 0.151450f, 0.159403f, -0.106886f, 0.061244f, 0.005169f, 0.005772f, 0.010295f, 0.996040f, -0.267713f, 0.153751f, 0.146390f, -0.106002f, 0.064300f, -0.002521f, 0.012867f, 0.015478f, 0.988416f, -0.260518f, 0.158655f, 0.137041f, -0.111547f, 0.063027f, -0.006363f, 0.017005f, 0.015128f, 0.984639f, -0.256278f, 0.158038f, 0.121578f, -0.114809f, 0.058237f, -0.002497f, 0.016325f, 0.016062f, 0.988569f, -0.256855f, 0.158718f, 0.100867f, -0.118304f, 0.062756f, 0.002455f, 0.014856f, 0.016297f, 0.993583f, -0.258219f, 0.158712f, 0.090190f, -0.112799f, 0.065262f, 0.004424f, 0.014576f, 0.017422f, 0.995612f, -0.258391f, 0.159610f, 0.071663f, -0.103369f, 0.061220f, 0.002110f, 0.014756f, 0.019847f, 0.993359f, -0.258101f, 0.161821f, 0.048391f, -0.106659f, 0.059650f, -0.000559f, 0.016298f, 0.016355f, 0.990748f, -0.256446f, 0.158132f, 0.035453f, -0.107982f, 0.062038f, -0.002944f, 0.016762f, 0.013516f, 0.988420f, -0.255866f, 0.155110f, 0.026981f, -0.106632f, 0.064141f, -0.001247f, 0.012383f, 0.011921f, 0.990173f, -0.260125f, 0.153346f, 0.023127f, -0.108275f, 0.064519f, 0.002848f, 0.006816f, 0.008017f, 0.994322f, -0.265568f, 0.149289f, 0.018097f, -0.108308f, 0.064129f, 0.002355f, 0.004847f, 0.006266f, 0.993882f, -0.267411f, 0.147401f, 0.014284f, -0.108405f, 0.062249f, 0.002721f, 0.003337f, 0.005892f, 0.994299f, -0.268790f, 0.146905f, 0.017654f, -0.103178f, 0.056800f, 0.003255f, 0.002416f, 0.004357f, 0.994884f, -0.269579f, 0.145261f, 0.015765f, -0.093474f, 0.049120f, 0.001301f, 0.007363f, 0.003094f, 0.992978f, -0.264496f, 0.143904f, 0.007847f, -0.085656f, 0.041762f, 0.001292f, 0.011735f, 0.003666f, 0.993016f, -0.259987f, 0.144395f, -0.005056f, -0.077342f, 0.032258f, 0.001470f, 0.009517f, 0.004042f, 0.993241f, -0.262064f, 0.144703f, -0.020432f, -0.072973f, 0.027008f, 0.002574f, 0.007305f, 0.004888f, 0.994391f, -0.264135f, 0.145494f, -0.029997f, -0.070649f, 0.030546f
};

#endif // TEST_SAMPLES_H
```
